## conf/layer.conf
```bitbake
# We have a conf and classes directory, add to BBPATH
BBPATH .= ":${LAYERDIR}"

# We have a packages directory, add to BBFILES
BBFILES += "${LAYERDIR}/recipes-*/*/*.bb \
            ${LAYERDIR}/recipes-*/*/*.bbappend"

BBFILE_COLLECTIONS += "fsl-arm-iris2"
BBFILE_PATTERN_fsl-arm-iris2 := "^${LAYERDIR}/"
BBFILE_PRIORITY_fsl-arm-iris2 = "4"

LAYERDEPENDS_fsl-arm-iris2 = "core fsl-arm"
```

## conf/machine/imx6-iris2.conf
```bitbake
#@TYPE: Machine
#@NAME: i.MX6 Variscite DART-MX6 on UVDL Iris2 and DT6CustomBoard
#@SOC: i.MX6Q
#@DESCRIPTION: Machine configuration for i.MX6 Variscite DART-MX6 on UVDL Iris2 and DT6CustomBoard
#@MAINTAINER: Bogdan Vacaliuc <bvacaliuc@gmail.com>

require conf/machine/include/imx-base.inc
require conf/machine/include/tune-cortexa9.inc

SOC_FAMILY = "mx6:mx6q"

PREFERRED_PROVIDER_u-boot = "u-boot-voipac"
PREFERRED_PROVIDER_virtual/bootloader_mx6 = "u-boot-voipac"
PREFERRED_PROVIDER_u-boot-voipac ?= "2015.04"
PREFERRED_PROVIDER_virtual/kernel_mx6 = "linux-uvdl"
PREFERRED_VERSION_linux-uvdl ?= "4.1"

UBOOT_CONFIG ??= "sata spi"
UBOOT_CONFIG[spi] = "mx6openrexmax_config"
UBOOT_CONFIG[sata] = "mx6openrexmaxsata_config"

KERNEL_IMAGETYPE = "zImage"
KERNEL_DEVICETREE = "imx6-openrexmax.dtb imx6-iris2-dt6c.dtb imx6-iris2-openrexmax.dtb imx6-iris2-r0.dtb"

SERIAL_CONSOLE = "115200 ttymxc0"

IMAGE_FSTYPES = "sdcard.gz tar.xz"

MACHINE_EXTRA_RRECOMMENDS += " \
	linux-firmware-iwlwifi-license linux-firmware-iwlwifi-3160-hmw linux-firmware-iwlwifi-4965-2 \
	linux-firmware-rtl-license linux-firmware-rtl8191se \
"

MACHINE_FEATURES += " pci wifi bluetooth 3g"
MACHINE_FIRMWARE_append_mx6 = " firmware-imx-vpu-imx6q firmware-imx-vpu-imx6d"
```
